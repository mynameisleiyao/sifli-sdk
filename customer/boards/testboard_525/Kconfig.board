## customer/boards/testboard_525/lcpu/Kconfig.board
```kconfig
config BSP_USING_BOARD_TESTBOARD_525
    bool
    select SOC_SF32LB52X
    select BF0_LCPU
    default y

rsource "../Kconfig.board"
```
